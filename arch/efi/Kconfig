## arch/efi/Kconfig
```kconfig
# SPDX-License-Identifier: GPL-2.0
#
# Copyright 2018 Peter Jones <pjones@redhat.com>

config ARCH_EFI
	bool
	default y
	# because we want it
	select ACPI
	# because we don't want to live long enough to need it
	select ARCH_NO_SWAP
	# wouldn't be ARCH=efi without also supporting EFI and the stub
	select EFI
	select EFI_STUB
	# this is how we display things
	select FB_EFI
	# this is how we boot a real kernel
	select KEXEC_FILE
	# this is how we manage memory
	select MMU
	# this is how we schedule
	select NO_HZ_FULL
	# this is because CONFIG_ACPI requires it
	# select PCI
	# these are because we don't have them someplace else
	select EARLY_EFI_PGT_DUMP

config MODULES
	def_bool !ARCH_EFI
	help
	  Just say 'N'

config MODULE_UNLOAD
	def_bool !ARCH_EFI
	help
	  Just say 'N'

config MODULE_FORCE_UNLOAD
	def_bool !ARCH_EFI
	help
	  Just say 'N'

config PCCARD
	def_tristate !ARCH_EFI
	help
	  Just say 'N'

config PCI_ENDPOINT
	def_bool !ARCH_EFI
	help
	  Just say 'N'

config SOUND
	def_tristate !ARCH_EFI
	depends on !ARCH_EFI
	help
	  Just say 'N'

#config USB
#	def_tristate !ARCH_EFI
#	depends on !ARCH_EFI
#	help
#	  Just say 'N'
#
# config
# 	def_tristate !ARCH_EFI
# 	def_bool !ARCH_EFI
# 	depends on !ARCH_EFI
# 	help
# 	  Just say 'N'

source "arch/$(HEADER_ARCH)/efi/Kconfig"

source "drivers/firmware/Kconfig"

source "arch/efi/drivers/Kconfig"
```

## arch/efi/configs/i386_defconfig
```kconfig
# CONFIG_COMPACTION is not set
CONFIG_BINFMT_MISC=y
CONFIG_HOSTFS=y
CONFIG_MAGIC_SYSRQ=y
CONFIG_SYSVIPC=y
CONFIG_POSIX_MQUEUE=y
CONFIG_NO_HZ_FULL=y
CONFIG_HZ_1000=y
CONFIG_HZ=1000
CONFIG_HIGH_RES_TIMERS=y
CONFIG_BSD_PROCESS_ACCT=y
CONFIG_IKCONFIG=y
CONFIG_IKCONFIG_PROC=y
CONFIG_LOG_BUF_SHIFT=14
CONFIG_CGROUPS=y
CONFIG_CGROUP_FREEZER=y
CONFIG_CGROUP_DEVICE=y
CONFIG_CPUSETS=y
CONFIG_CGROUP_CPUACCT=y
CONFIG_CGROUP_SCHED=y
CONFIG_BLK_CGROUP=y
# CONFIG_PID_NS is not set
CONFIG_SYSFS_DEPRECATED=y
CONFIG_CC_OPTIMIZE_FOR_SIZE=y
CONFIG_SLAB=y
CONFIG_MODULES=y
CONFIG_MODULE_UNLOAD=y
# CONFIG_BLK_DEV_BSG is not set
CONFIG_IOSCHED_CFQ=y
CONFIG_SSL=y
CONFIG_NULL_CHAN=y
CONFIG_PORT_CHAN=y
CONFIG_PTY_CHAN=y
CONFIG_TTY_CHAN=y
CONFIG_XTERM_CHAN=y
CONFIG_CON_CHAN="pts"
CONFIG_SSL_CHAN="pts"
CONFIG_UEVENT_HELPER_PATH="/sbin/hotplug"
CONFIG_DEVTMPFS=y
CONFIG_DEVTMPFS_MOUNT=y
CONFIG_BLK_DEV_UBD=y
CONFIG_BLK_DEV_LOOP=y
CONFIG_BLK_DEV_NBD=y
CONFIG_DUMMY=y
CONFIG_TUN=y
CONFIG_PPP=y
CONFIG_SLIP=y
CONFIG_LEGACY_PTY_COUNT=32
# CONFIG_HW_RANDOM is not set
CONFIG_NET=y
CONFIG_PACKET=y
CONFIG_UNIX=y
CONFIG_INET=y
CONFIG_IPV6=y
CONFIG_EXT4_FS=y
CONFIG_REISERFS_FS=y
CONFIG_QUOTA=y
CONFIG_AUTOFS4_FS=y
CONFIG_ISO9660_FS=y
CONFIG_JOLIET=y
CONFIG_PROC_KCORE=y
CONFIG_TMPFS=y
CONFIG_NLS=y
CONFIG_DEBUG_INFO=y
CONFIG_DEBUG_KERNEL=y
CONFIG_ISA=n
CONFIG_SBUS=n
CONFIG_PCI=n
CONFIG_PCMCIA=n
CONFIG_PGTABLE_LEVELS=2
CONFIG_SMP=y
```

## arch/efi/configs/x86_64_defconfig
```kconfig
# CONFIG_COMPACTION is not set
CONFIG_BINFMT_MISC=y
CONFIG_IA32_EMULATION=y
CONFIG_HOSTFS=y
CONFIG_MAGIC_SYSRQ=y
CONFIG_SYSVIPC=y
CONFIG_POSIX_MQUEUE=y
CONFIG_NO_HZ_FULL=y
CONFIG_HZ_1000=y
CONFIG_HZ=1000
CONFIG_HIGH_RES_TIMERS=y
CONFIG_BSD_PROCESS_ACCT=y
CONFIG_IKCONFIG=y
CONFIG_IKCONFIG_PROC=y
CONFIG_LOG_BUF_SHIFT=14
CONFIG_CGROUPS=y
CONFIG_CGROUP_FREEZER=y
CONFIG_CGROUP_DEVICE=y
CONFIG_CPUSETS=y
CONFIG_CGROUP_CPUACCT=y
CONFIG_CGROUP_SCHED=y
CONFIG_BLK_CGROUP=y
# CONFIG_PID_NS is not set
CONFIG_SYSFS_DEPRECATED=y
CONFIG_CC_OPTIMIZE_FOR_SIZE=y
CONFIG_SLAB=y
CONFIG_MODULES=y
CONFIG_MODULE_UNLOAD=y
# CONFIG_BLK_DEV_BSG is not set
CONFIG_IOSCHED_CFQ=y
CONFIG_SSL=y
CONFIG_NULL_CHAN=y
CONFIG_PORT_CHAN=y
CONFIG_PTY_CHAN=y
CONFIG_TTY_CHAN=y
CONFIG_XTERM_CHAN=y
CONFIG_CON_CHAN="pts"
CONFIG_SSL_CHAN="pts"
CONFIG_UEVENT_HELPER_PATH="/sbin/hotplug"
CONFIG_DEVTMPFS=y
CONFIG_DEVTMPFS_MOUNT=y
CONFIG_BLK_DEV_UBD=y
CONFIG_BLK_DEV_LOOP=y
CONFIG_BLK_DEV_NBD=y
CONFIG_DUMMY=y
CONFIG_TUN=y
CONFIG_PPP=y
CONFIG_SLIP=y
CONFIG_LEGACY_PTY_COUNT=32
# CONFIG_HW_RANDOM is not set
CONFIG_NET=y
CONFIG_PACKET=y
CONFIG_UNIX=y
CONFIG_INET=y
CONFIG_IPV6=y
CONFIG_EXT4_FS=y
CONFIG_REISERFS_FS=y
CONFIG_QUOTA=y
CONFIG_AUTOFS4_FS=y
CONFIG_ISO9660_FS=y
CONFIG_JOLIET=y
CONFIG_PROC_KCORE=y
CONFIG_TMPFS=y
CONFIG_NLS=y
CONFIG_DEBUG_INFO=y
CONFIG_FRAME_WARN=1024
CONFIG_DEBUG_KERNEL=y
# CONFIG_ISA is not set
# CONFIG_SBUS is not set
# CONFIG_PCI is not set
# CONFIG_PCMCIA is not set
CONFIG_PGTABLE_LEVELS=4
CONFIG_SMP=y
CONFIG_HAVE_ARCH_THREAD_STRUCT_WHITELIST=y
CONFIG_HAVE_ARCH_WITHIN_STACK_FRAMES=y
CONFIG_AMD_MEM_ENCRYPT=y
CONFIG_ARCH_EFI=y
CONFIG_ARCH_EFI_X86=y
CONFIG_HAVE_STACK_VALIDATION=n
CONFIG_HAVE_RELIABLE_STACKTRACE=n
# CONFIG_X86_VSMP is not set
CONFIG_HYPERVISOR_GUEST=y
CONFIG_PARAVIRT=y
CONFIG_KVM_GUEST=y
CONFIG_XEN=y
CONFIG_XEN_PV=y
CONFIG_XEN_PV_SMP=y
CONFIG_XEN_DOM0=y
CONFIG_XEN_PVHVM=y
CONFIG_XEN_PVHVM_SMP=y
CONFIG_XEN_512GB=y
CONFIG_XEN_SAVE_RESTORE=y
CONFIG_XEN_DEBUG_FS=y
CONFIG_XEN_PVH=y
```

## arch/efi/drivers/Kconfig
```kconfig
# SPDX-License-Identifier: GPL-2.0

menu "EFI-Mode Character Devices"

config NULL_CHAN
	bool "null channel support"
	help
	  This option enables support for attaching EFI-Mode consoles and serial
	  lines to a device similar to /dev/null.  Data written to it disappears
	  and there is never any data to be read.

config NOCONFIG_CHAN
	bool
	default !(NULL_CHAN)

endmenu

menu "EFI-Mode Network Devices"
	depends on NET

# EFI-Mode virtual driver
config ARCH_EFI_NET
	bool "Virtual network device"
	help
	  While the EFI-Mode port cannot directly talk to any physical
	  hardware devices, this choice and the following transport options
	  provide one or more virtual network devices through which the EFI-Mode
	  kernels can talk to each other, the host, and with the host's help,
	  machines on the outside world.

	  If you'd like to be able to enable networking in the EFI-Mode
	  linux environment, say Y; otherwise say N.

endmenu
```

## arch/x86/efi/Kconfig
```kconfig
# SPDX-License-Identifier: GPL-2.0
#
# Copyright 2018 Peter Jones <pjones@redhat.com>

menu "Host processor type and features"

endmenu

config 64BIT
	bool "64-bit kernel" if "$(SUBARCH)" = "x86"
	default "$(SUBARCH)" != "i386"

config OUTPUT_FORMAT
	string
	default "elf32-i386" if X86_32
	default "elf64-x86-64" if X86_64

config ARCH_DEFCONFIG
	string
	default "arch/efi/configs/i386_defconfig" if X86_32
	default "arch/efi/configs/x86_64_defconfig" if X86_64

config ARCH_EFI_X86
	def_bool y
	select GENERIC_FIND_FIRST_BIT
	select ARCH_EFI

config ARCH_HYBERNATION_POSSIBLE
	def_bool !ARCH_EFI_X86

config ARCH_SUSPEND_POSSIBLE
	def_bool !ARCH_EFI_X86

config X86_SYSFB
	def_bool !ARCH_EFI

source "arch/x86/Kconfig"
```
